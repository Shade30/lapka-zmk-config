## boards/shields/lapka_36/Kconfig.defconfig
```kconfig
if SHIELD_LAPKA_36_DONGLE

config ZMK_KEYBOARD_NAME
  default "Lapka"

config ZMK_USB
  default y

config ZMK_STUDIO
  default y

config ZMK_SPLIT_BLE_ROLE_CENTRAL
  default y

config ZMK_SPLIT_BLE_CENTRAL_PERIPHERALS
  default 2

config BT_MAX_CONN
  default 5

config BT_MAX_PAIRED
  default 5

endif

if SHIELD_LAPKA_36_LEFT || SHIELD_LAPKA_36_RIGHT || SHIELD_LAPKA_36_DONGLE

config ZMK_SPLIT
  default y

config ZMK_BLE
  default y

endif
```

## boards/shields/lapka_36/Kconfig.shield
```kconfig
config SHIELD_LAPKA_36_LEFT
	def_bool $(shields_list_contains,lapka_36_left)

config SHIELD_LAPKA_36_RIGHT
	def_bool $(shields_list_contains,lapka_36_right)

config SHIELD_LAPKA_36_DONGLE
	def_bool $(shields_list_contains,lapka_36_dongle)
```
